## base_external/package/aesdchar/Config.in
```kconfig
config BR2_PACKAGE_AESDCHAR
	bool "aesdchar"
	depends on BR2_LINUX_KERNEL
	help
	  Includes the misc_modules and scull devices in the kernel image.
	  Used to understand buildroot external trees and package builds.
```

## base_external/package/ldd/Config.in
```kconfig
config BR2_PACKAGE_LDD
	bool "ldd"
	depends on BR2_LINUX_KERNEL
	help
	  Includes the misc_modules and scull devices in the kernel image.
	  Used to understand buildroot external trees and package builds.
```
